## Kconfig
```kconfig
mainmenu "C/CPP CMake project framework Kconfig configuration"

menu "Toolchain configuration"
	config TOOLCHAIN_PATH
		string "toolchain path"
		default ""

	config TOOLCHAIN_PREFIX
		string "toolchain prefix"
		default ""
	
	config SYSTEM_PROCESSOR
		string "target processor architecture"
		default "X86_64"

	config SYSTEM_NAME
		string "target system name"
		default ""
endmenu

menu "SDK Components Configuration"
	osource "${SDK_PATH}/components/*/Kconfig"
	osource "${CUSTOM_COMPONENTS_PATH}/*/Kconfig"
endmenu
menu "Project Components Configuration"
	osource "${PROJECT_PATH}/../components/*/Kconfig"
	osource "${PROJECT_PATH}/*/Kconfig"
	osource "${PROJECT_PATH}/components/*/Kconfig"
endmenu
```
